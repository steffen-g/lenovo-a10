## kernel/arch/arm/mach-rk3188/Kconfig
```kconfig
choice
	prompt "Rockchip SoC Type"
	depends on ARCH_RK3188

config SOC_RK3188
	bool "RK3188"

endchoice

choice
	prompt "RK3188 Board Type"
	depends on SOC_RK3188

config MACH_RK3188_TB
	bool "RK3188 Top Board"
	select USB_ARCH_HAS_EHCI

config MACH_RK3188_FPGA
	bool "RK3188 FPGA board"
	select RK_FPGA

config MACH_RK3188_LR097
        bool "RK3188 LR097 JC21CA board"

config MACH_RK3188_DS1006H
	bool "RK3188 ds1006h board"

config MACH_RK3188_V80
    bool "RK3188 v80 board"

config MACH_RK3188_V80_V10
    bool "RK3188 v80 v1.0 board"

config MACH_RK3188_S115A
    bool "RK3188 s115a board"
	select USB_ARCH_HAS_EHCI

config MACH_RK3188_FLEX10
    bool "RK3188 flex10 board"
    select USB_ARCH_HAS_EHCI

config MACH_RK3188_A10
    bool "RK3188 a10 board"
	select USB_ARCH_HAS_EHCI
endchoice
```

## kernel/drivers/headset_observe/Kconfig
```kconfig
#
# Headset device configuration
#

menu "Headset device support"

config RK_HEADSET_DET
	tristate "RK headset detect support"
	---help---
		Universal headphone driver(write begin rk29)

config RK_HEADSET_IRQ_HOOK_ADC_DET
	tristate "RK headset irq hook adc detect support"
	---help---
		if you use headset irq and hook adc detect, choose it

config SOUND_EX_FUN 
    bool "sound external function support"
    default n
	---help---
        sound external function 
endmenu
```

## kernel/drivers/misc/3g_module/Kconfig
```kconfig
#
# 3G device configuration
#

menuconfig 3G_MODULE
	tristate "3G module for phonepad"
	---help---
	  Say Y here if you have a support modem

if 3G_MODULE
    config MU509
		bool "MU509"

    config MT6229
    	bool "MT6229"

    config MW100
    	bool "MW100"

    config SEW868
		bool "SEW868"	

    config MI700
		bool "MI700"	
	config SC6610
		bool "SC6610"	
endif
```

## kernel/drivers/misc/board-id/Kconfig
```kconfig
menuconfig BOARD_ID
	bool "board id select devices support"
	default n	
	
if BOARD_ID
config BOARD_ID_VENDOR
bool "board id save in vendor"
	default n

config BOARD_ID_AUTO_XML
bool "auto print xml"
	default n

config BOARD_ID_IDBLOCK
bool "board id save in idblock"
	default n

config BOARD_ID_HW
bool "board id get from hardware"
	default n
	
endif
```

## kernel/drivers/misc/ec/Kconfig
```kconfig
#
# EC control drivers configuration
#

menuconfig EC_DEV
	bool "ec control driver support"
	default n	

if EC_DEV

	config EC_DEV_I2C
	bool "ec use i2c interface"
	default n

	source "drivers/misc/ec/modules/Kconfig"
	
	config EC_DEV_SPI
	bool "ec use spi interface"
	default n
endif
```

## kernel/drivers/misc/ec/modules/Kconfig
```kconfig
#
# ec modules configuration
#
if EC_DEV_I2C || EC_DEV_SPI
	config EC_FIRMWARE
	tristate "update ec firmware from rk"
	default n

	config EC_KEY
	tristate "ec keyboard support"
	default n

	config EC_TP
	tristate "ec touch pad support"
	default n

	config EC_PS2
	tristate "ec ps2 support"
	default n

	config EC_LED
	tristate "ec led control support"
	default n

	config EC_BATTERY
	tristate "ec battery driver support"
	default n

	config EC_CHARGE
	tristate "ec charge control support"
	default n

	config EC_GPIO
	tristate "ec gpio extend support"
	default n

	config EC_ADC
	tristate "ec adc extend support"
	default n
endif
```

## kernel/drivers/video/display/screen/lcd-board-id/Kconfig
```kconfig
config LCD_BOARD_ID_M101NWN8
	bool "IVO M101NWN8 1366x768 for board id"
	depends on LCD_BOARD_ID
        default y
        
config LCD_EDID_I2C
	bool "lcd support edid such as M101NWN8"
	depends on LCD_BOARD_ID
	    default y
```
